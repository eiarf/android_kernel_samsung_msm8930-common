## arch/arm/configs/msm8930_serrano_eur_3g_defconfig
```kconfig
CONFIG_MACH_SERRANO_EUR_3G=y
CONFIG_PM8921_BMS=y
CONFIG_PM8921_CHARGER=y
CONFIG_PM8921_SEC_CHARGER=y
CONFIG_SAMSUNG_LPM_MODE=y
CONFIG_USB_SWITCH_TSU6721=y
CONFIG_SWAP=y
CONFIG_ZSMALLOC=y
CONFIG_ZRAM=y

CONFIG_EXT_SPK_AMP=y
```
